## arch/arm/mach-eys3d/Kconfig
```kconfig
# SPDX-License-Identifier: (GPL-2.0-only OR BSD-2-Clause)

menuconfig ARCH_EYS3D
	bool "eYs3D SoCs"
	depends on ARCH_MULTI_V7
	help
	  Support for eYs3D SoC family: SP7021 and succeeding SoC-based systems,
	  such as the Banana Pi BPI-F2S development board (and derivatives).
	  (<http://www.sinovoip.com.cn/ecp_view.asp?id=586>)
	  (<https://tibbo.com/store/plus1.html>)

config SOC_SP7021
	bool "eYs3D SP7021 SoC support"
	depends on ARCH_EYS3D
	default ARCH_EYS3D
	select HAVE_ARM_ARCH_TIMER
	select ARM_GIC
	select ARM_PSCI
	select PINCTRL
	select PINCTRL_SPPCTL
	select SERIAL_EYS3D if TTY
	select SERIAL_EYS3D_CONSOLE if TTY
	help
	  Support for eYs3D SP7021 SoC. It is based on ARM 4-core
	  Cortex-A7 with various peripherals (e.g.: I2C, SPI, SDIO,
	  Ethernet, etc.), FPGA interface,  chip-to-chip bus.
	  It is designed for industrial control.
```

## drivers/gpu/drm/eys3d/ecv5546/Kconfig
```kconfig
# SPDX-License-Identifier: GPL-2.0
#
# eys3d drm device configuration.

config DRM_eCV5546
	tristate "DRM Support for EYS3D eCV5546"
	depends on DRM
	depends on VIDEO_DEV && SOC_eCV5546
	select DRM_MIPI_DSI
	select DRM_KMS_HELPER
	select DRM_KMS_DMA_HELPER
	select DRM_GEM_DMA_HELPER
	default y
	help
	   This option enables support for the eYs3D eCV5546 SoCs with a
	   Display Engine.
	   This driver is necessary for drm framework that wishes to utilize the
	   SoCs Hardware Display for its intended purposes. Without this driver,
	   the device will not be recognized or accessible by the system.
	   Please note that this driver requires the SOC_eCV5546 and VIDEO_DEV
	   to be enabled as well, as it depends on certain functionality
	   provided by that option.

config DRM_PANEL_eCV5546_SIMPLE_DSI
	tristate "support for eys3d simple dsi panels"
	depends on OF
	depends on DRM_eCV5546
	select VIDEOMODE_HELPERS
	default y
	help
	  DRM panel driver for dumb panels that need at most a regulator and
	  a GPIO to be powered up. Optionally a backlight can be attached so
	  that it can be automatically turned off when the panel goes into a
	  low power state.
```

## drivers/media/platform/eys3d/Kconfig
```kconfig
# SPDX-License-Identifier: GPL-2.0


source "drivers/media/platform/eys3d/display/ecv5546/Kconfig"
source "drivers/media/platform/eys3d/mipicsi/Kconfig"
source "drivers/media/platform/eys3d/gdc/Kconfig"
```

## drivers/media/platform/eys3d/display/ecv5546/Kconfig
```kconfig
# SPDX-License-Identifier: GPL-2.0

config VIDEO_eCV5546_DISP
	tristate "eYs3D eCV5546 Display Driver"
	depends on VIDEO_DEV && V4L_PLATFORM_DRIVERS && SOC_eCV5546
	select VIDEOBUF2_DMA_CONTIG
	select VIDEOBUF2_VMALLOC
	# select FB_eCV5546
	default n
	help
	  Support for the eYs3D eCV5546 display driver.

config VIDEO_eCV5546_DISP_DEBUG
	bool "External Debug Support"
	depends on VIDEO_eCV5546_DISP
	help
	  Say Y here, if you want to have debug support.
	  Debug function is reserved for display further check.
	  echo "dump all" > /sys/module/display_ecv5546/parameter/debug
	  can show more detailed information for display driver.

config VIDEO_eCV5546_DISP_PI_PANEL
	bool "Built-in Raspberry Pi 7-inch Touch-screen I2C Controller"
	depends on VIDEO_eCV5546_DISP
	default n
	help
	  Say Y here, if you want to use Raspberry Pi 7-inch touch-screen
	  800x480 DSI panel.
	  Note that this I2C controller only supports DSI function.
	  It does not include touch-screen function.

config VIDEO_eCV5546_DISP_LT8912B
	bool "Built-in LT8912B DSI-to-HDMI Bridge (I2C) Controller"
	depends on VIDEO_eCV5546_DISP
	default n
	help
	  Say Y here, if you want to use Lontium LT8912B DSI-to-HDMI bridge.
```

## drivers/media/platform/eys3d/gdc/Kconfig
```kconfig
# SPDX-License-Identifier: GPL-2.0
#
# eYs3D Geometric Distortion Correction driver configuration
#

config VIDEO_EYS3D_GDC
	bool "eYs3D Geometric Distortion Correction Driver"
	depends on VIDEO_DEV
	select VIDEOBUF2_DMA_CONTIG
	select V4L2_MEM2MEM_DEV
	select V4L_MEM2MEM_DRIVERS
	help
	  Support for the eYs3D Geometric Distortion Correction driver

config VIDEO_EYS3D_GDC_eCV5546
	bool "Geometric Distortion Correction Driver for eCV5546"
	depends on VIDEO_EYS3D_GDC
	help
	  Support for the eYs3D eCV5546 Geometric Distortion Correction driver
```

## drivers/media/platform/eys3d/mipicsi/Kconfig
```kconfig
# SPDX-License-Identifier: GPL-2.0
#
# eYs3D MIPI/CSI RX driver configuration
#

config VIDEO_EYS3D_eCV5546_CSI2
	tristate "eYs3D eCV5546 MIPI CSI-2 RX Driver"
	depends on VIDEO_DEV && OF
	depends on SOC_eCV5546
	select MEDIA_CONTROLLER
	select VIDEO_V4L2_SUBDEV_API
	select RESET_CONTROLLER
	select V4L2_FWNODE
	help
	  Support for eYs3D MIPI CSI-2 receiver.
	  Supports eCV5546 SoC.

	  To compile this driver as a module, choose M here: the
	  module will be called sp-mipi-ecv5546.

config VIDEO_EYS3D_eCV5546_VIN
	tristate "eYs3D eCV5546 Video Input (VIN) Driver"
	depends on VIDEO_DEV && OF
	depends on SOC_eCV5546
	select MEDIA_CONTROLLER
	select VIDEO_V4L2_SUBDEV_API
	select VIDEOBUF2_DMA_CONTIG
	select V4L2_FWNODE
	help
	  Support for eYs3D Video Input (VIN) driver.
	  Supports eCV5546 SoC.

	  To compile this driver as a module, choose M here: the
	  module will be called sp-vin-ecv5546.
```

## drivers/net/ethernet/eys3d/Kconfig
```kconfig
# SPDX-License-Identifier: GPL-2.0
#
# eYs3D network device configuration
#

config NET_VENDOR_EYS3D
	bool "eYs3D devices"
	default y
	depends on ARCH_EYS3D || COMPILE_TEST
	help
	  If you have a network (Ethernet) card belonging to this
	  class, say Y here.

	  Note that the answer to this question doesn't directly
	  affect the kernel: saying N will just cause the configurator
	  to skip all the questions about eYs3D cards. If you say Y,
	  you will be asked for your specific card in the following
	  questions.

if NET_VENDOR_EYS3D

config SP7021_EMAC
	tristate "eYs3D Dual 10M/100M Ethernet devices"
	depends on SOC_SP7021 || COMPILE_TEST
	select PHYLIB
	help
	  If you have eYs3D dual 10M/100M Ethernet devices, say Y.
	  The network device creates two net-device interfaces.
	  To compile this driver as a module, choose M here. The
	  module will be called sp7021_emac.

endif # NET_VENDOR_EYS3D
```

## drivers/phy/eys3d/Kconfig
```kconfig
# SPDX-License-Identifier: GPL-2.0-only

config PHY_EYS3D_USB
	tristate "eYs3D SP7021 USB 2.0 PHY driver"
	depends on OF && (SOC_SP7021 || COMPILE_TEST)
	select GENERIC_PHY
	help
	  Enable this to support the USB 2.0 PHY on eYs3D SP7021
	  SoC. The USB 2.0 PHY controller supports battery charger
	  and synchronous signals, various power down modes including
	  operating, partial and suspend modes, and high-speed,
	  full-speed and low-speed data transfer.

config PHY_EYS3D_eCV5546_USB
	tristate "eYs3D eCV5546 USB 2.0 PHY driver"
	depends on OF && (SOC_eCV5546 || COMPILE_TEST)
	select GENERIC_PHY
	help
	  Enable this to support the USB 2.0 PHY on eYs3D eCV5546
	  SoC. The USB 2.0 PHY controller supports battery charger
	  and synchronous signals, various power down modes including
	  operating, partial and suspend modes, and high-speed,
	  full-speed and low-speed data transfer.
```

## drivers/pinctrl/eys3d/Kconfig
```kconfig
# SPDX-License-Identifier: GPL-2.0
#
# eYs3D Pin control driver configuration
#

config PINCTRL_SPPCTL
	tristate "eYs3D SP7021 PinMux and GPIO driver"
	depends on SOC_SP7021
	depends on OF && HAS_IOMEM
	select GENERIC_PINCTRL_GROUPS
	select GENERIC_PINMUX_FUNCTIONS
	select GENERIC_PINCONF
	select PINCONF
	select PINMUX
	select GPIOLIB
	select OF_GPIO
	help
	  Say Y here to support eYs3D SP7021 pinmux controller.
	  This driver requires the pinctrl framework.
	  GPIO is provided by the same driver.
	  To compile this driver as a module, choose M here.
	  The module will be called sppinctrl.

config PINCTRL_eCV5546
	bool "eYs3D eCV5546 pin control and GPIO driver"
	depends on SOC_eCV5546
	depends on OF && HAS_IOMEM
	select PINMUX
	select GENERIC_PINCTRL_GROUPS
	select GENERIC_PINMUX_FUNCTIONS
	select PINCONF
	select GENERIC_PINCONF
	select OF_GPIO
	select GPIOLIB
	select GPIO_SYSFS
	select GENERIC_IRQ_CHIP
	select GPIOLIB_IRQCHIP
	help
	  Say Y here to support eYs3D eCV5546 pin controller.
	  The driver is selected automatically by platform.
	  This driver requires the pinctrl framework.
	  GPIO is provided by the same driver.

config PINCTRL_DEBUG
	bool "eYs3D pin control specific debug"
	depends on SOC_eCV5546 && DEBUG_PINCTRL
	help
	  Say Y if you need to debug eYs3D pinmux driver in-depth.
	  Pin control driver will output more messages if you enable
	  this item. This function is dependent on DEBUG_PINCTRL. It
	  should be enabled first.
```

## drivers/soc/eys3d/Kconfig
```kconfig
#
# AXI Bus subsystem configuration
#
menu "eYs3D SoC drivers"

config EYS3D_AXI_MONITOR
	tristate "eYs3D AXI monitor driver"
	default n
	help
	  eYs3D breakpoint analysis of backbone-dram problem.
	  In order to speed up the breakpoint analysis of the
	  BackBone-Dram proble. Quickly locate which Master/Slave
	  caused the system to crash.

config EYS3D_AXI_ARBITER
	tristate "eYs3D AXI arbiter driver"
	default n
	help
	  Support issue rate limiter. Support dynamic AMBA Qos.
	  Support total data accumulation for write and read.

endmenu
```

## drivers/video/fbdev/eys3d/fb_ecv5546/Kconfig
```kconfig
# SPDX-License-Identifier: GPL-2.0
config FB_eCV5546
	tristate "eCV5546 framebuffer support"
	depends on FB && SOC_eCV5546 && VIDEO_eCV5546_DISP
	select FB_CFB_FILLRECT
	select FB_CFB_COPYAREA
	select FB_CFB_IMAGEBLIT
	help
	  Frame buffer driver for eCV5546 based boards.
	  Default y if eCV5546 display driver exists.
	  eCV5546 support framebuffer console.

config FB_eCV5546_DEBUG
	bool "External Debug support"
	depends on FB_eCV5546
	help
	  Say Y here, if you want to have debug support.
	  Debug function reserved for fb further check.
	  echo "fbinfo" > /sys/module/ecv5546fb/parameter/debug
	  can show more info for framebuffer details.
```

## sound/soc/eys3d/Kconfig
```kconfig
menuconfig SND_SOC_EYS3D
	tristate "ASoC support for eYs3D"
	#depends on ARCH_EYS3D
	select SND_SOC_SPDIF
	default y
	help
	  Say Y or M if you want to add support for codecs attached to
	  the eYs3D SoCs' Audio interfaces. You will also need to
	  select the audio interfaces to support below.

config SND_SOC_AUD_eCV5546
	tristate "support eCV5546 codec"
	depends on SND_SOC_EYS3D && SOC_eCV5546
	default y
```
